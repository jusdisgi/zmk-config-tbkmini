## boards/shields/tbkmini/Kconfig.defconfig
```kconfig
if SHIELD_TBKMINI_LEFT

# Name must be less than 16 characters long!
config ZMK_KEYBOARD_NAME
    default "TBK Mini"

config ZMK_SPLIT_ROLE_CENTRAL
    default y

endif

if SHIELD_TBKMINI_LEFT || SHIELD_TBKMINI_RIGHT
config ZMK_SPLIT
    default y
endif
```
